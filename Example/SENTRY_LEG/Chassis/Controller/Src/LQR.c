#include "LQR.h"

//定腿长下增益矩阵
//     -1.0372,  -2.5505,  -5.238,  -0.95501,  -19.426,  -0.84491,  -2.6521,  -0.33033,  -14.171,  -1.9019
//     -1.0372,  -2.5505,  5.238,  0.95501,  -2.6521,  -0.33033,  -19.426,  -0.84491,  -14.171,  -1.9019
//     1.6789,  4.0364,  -24.216,  -5.0734,  47.552,  1.8287,  -9.5701,  -0.060787,  -54.025,  -5.969
//     1.6789,  4.0364,  24.216,  5.0734,  -9.5701,  -0.060787,  47.552,  1.8287,  -54.025,  -5.969

//变腿长下多项式拟合的全部系数
float P[40][6] = 
{ 
		 -0.8773,  -6.6633,  5.637,  10.728,  -4.8341,  -5.0894       ,
     -2.7445,  -14.28,  16.342,  27.193,  -18.672,  -13.913       ,
     -10.73,  45.182,  -11.792,  -57.676,  27.376,  13.344        ,
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     -3.0219,  7.8708,  -29.845,  -11.313,  11.901,  30.549
};

//定义控制矩阵
float u[10];

//定义拟合增益矩阵
float Fitting_K[4][10];

void Fitting_K_Calc(float (*fitting_k)[10],float (*p)[6],float L_l,float L_r)
{
	static unsigned short int i = 0;
	static unsigned short int j = 0;
	
	for(i=0;i<=3;i++)
	{
		for(j=0;j<=9;j++)
		{
			fitting_k[i][j] = p[i*10+j][0] + p[i*10+j][1]*L_l + p[i*10+j][2]*L_r + p[i*10+j][3]*(L_l*L_l) + p[i*10+j][4]*L_l*L_r + p[i*10+j][5]*(L_r*L_r);
		}
	}
}

void LQR_Calc(Flag_Bit_t *flag,
							Goal_Setting_t *goal,
							Compensation_Amount_t *comp,
							Body_Current_Situation_t *body,
							Leg_Current_Situation_t *leg[2],
							Joint_Motor_Status_t *joint_m[2])
{
	//bz:|0,T_wl|1,T_wr|2,T_bl|3,T_br|
	static float T[4];
	static unsigned short int i = 0;
	
	u[0] = Max_Output(comp->Gravity_Comp_X      -        body->x,      X_MAX); u[1] =   goal->d_x_t -       body->d_x;
	u[2] = Max_Output(Find_Min_RADIAN(body->abs_yaw,goal->yaw_t),    Yaw_MAX); u[3] = goal->d_yaw_t -     body->d_yaw;
	u[4] = Max_Output(comp->Gravity_Comp_Theta  -  leg[0]->theta,Theta_L_MAX); u[5] =             0 - leg[0]->d_theta;
	u[6] = Max_Output(comp->Gravity_Comp_Theta  -  leg[1]->theta,Theta_R_MAX); u[7] =             0 - leg[1]->d_theta;
	u[8] = Max_Output(                       0  -    body->theta,Theta_B_MAX); u[9] =             0 -   body->d_theta;
	
	//打滑取消YAW增益提高腿杆THETA增益
	if(flag->slip_flag[0]||flag->slip_flag[1]) 
	{
		if(flag->slip_flag[0])
		{
			Fitting_K[0][2] = 0; Fitting_K[0][3] = 0; 					
			Fitting_K[2][2] = 0; Fitting_K[2][3] = 0; 	
			
			Fitting_K[0][4] = Fitting_K[0][4]*2.0f; Fitting_K[0][6] = Fitting_K[0][6]*2.0f; 
			Fitting_K[2][4] = Fitting_K[2][4]*2.0f; Fitting_K[2][6] = Fitting_K[2][6]*2.0f;
		}
		if(flag->slip_flag[1])
		{
			Fitting_K[1][2] = 0; Fitting_K[1][3] = 0; 					
			Fitting_K[3][2] = 0; Fitting_K[3][3] = 0; 	
			
			Fitting_K[1][4] = Fitting_K[1][4]*2.0f; Fitting_K[1][6] = Fitting_K[1][6]*2.0f; 
			Fitting_K[3][4] = Fitting_K[3][4]*2.0f; Fitting_K[3][6] = Fitting_K[3][6]*2.0f;
		}
	}
	
	//腿杆异常取消YAW增益提高腿杆THETA增益
	if(flag->theta_flag[0]||flag->theta_flag[1]) 
	{
		if(flag->theta_flag[0])
		{
			Fitting_K[0][2] = 0; Fitting_K[0][3] = 0; 					
			Fitting_K[2][2] = 0; Fitting_K[2][3] = 0; 	
			
			Fitting_K[0][4] = Fitting_K[0][4]*2.0f; Fitting_K[0][6] = Fitting_K[0][6]*2.0f; 
			Fitting_K[2][4] = Fitting_K[2][4]*2.0f; Fitting_K[2][6] = Fitting_K[2][6]*2.0f;
		}
		if(flag->theta_flag[1])
		{
			Fitting_K[1][2] = 0; Fitting_K[1][3] = 0; 					
			Fitting_K[3][2] = 0; Fitting_K[3][3] = 0; 	
			
			Fitting_K[1][4] = Fitting_K[1][4]*2.0f; Fitting_K[1][6] = Fitting_K[1][6]*2.0f; 
			Fitting_K[3][4] = Fitting_K[3][4]*2.0f; Fitting_K[3][6] = Fitting_K[3][6]*2.0f;
		}
	}

	for(i=0;i<=3;i++)
	{
		if(!flag->off_flag) 
		{
			if(!flag->spinning_flag) 
			{
				T[i] = u[0]*Fitting_K[i][0] + u[1]*Fitting_K[i][1]
						 - u[2]*Fitting_K[i][2] + u[3]*Fitting_K[i][3]
						 + u[4]*Fitting_K[i][4] + u[5]*Fitting_K[i][5] 
						 + u[6]*Fitting_K[i][6] + u[7]*Fitting_K[i][7] 
						 + u[8]*Fitting_K[i][8] + u[9]*Fitting_K[i][9];	
			}
			else //小陀螺取消X位移,YAW位置增益
			{
				T[i] =                    0      + u[1]*Fitting_K[i][1] 
						 -                    0      + u[3]*Fitting_K[i][3]*1.2f
						 + u[4]*Fitting_K[i][4]*1.4f + u[5]*Fitting_K[i][5]*1.0f
						 + u[6]*Fitting_K[i][6]*1.4f + u[7]*Fitting_K[i][7]*1.0f
						 + u[8]*Fitting_K[i][8]*3.0f + u[9]*Fitting_K[i][9]*1.6f;
			}
		}
		else //离地时只控制腿杆垂直
		{
			T[i] = u[4]*Fitting_K[i][4] + u[5]*Fitting_K[i][5] 
					 + u[6]*Fitting_K[i][6] + u[7]*Fitting_K[i][7];
		}
	}

	//输出赋值
	joint_m[0]->T_Wheel = T[0]; joint_m[1]->T_Wheel = T[1];
	joint_m[0]->Tp      = T[2]; joint_m[1]->Tp      = T[3];	
}








